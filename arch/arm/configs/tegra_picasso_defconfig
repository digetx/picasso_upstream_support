## drivers/staging/a500/Kconfig
```kconfig
config A500
	bool "Acer A500 drivers"
	depends on ARCH_TEGRA
	default n
	---help---
	  Say Y here to build Acer A500 tablet device drivers.

if A500

source "drivers/staging/a500/ec/Kconfig"

endif # A500
```

## drivers/staging/a500/ec/Kconfig
```kconfig
config MFD_EC_A500
	bool "Embedded Controller driver for Acer A50x tablets"
	depends on I2C && ARCH_TEGRA
	select MFD_CORE
	help
	  Say Y to include support for Acer A50x compliant embedded
	  controller.

config EC_A500_LEGACY_SYSFS
	tristate "Legacy A50x EC sysfs for Android compatibility"
	depends on MFD_EC_A500
	help
	  Say Y to include support for Acer A50x EC legacy sysfs.

config EC_A500_BATTERY
	tristate "Acer A50x battery driver"
	depends on MFD_EC_A500 && POWER_SUPPLY
	help
	  Say Y to include support for battery behind A500 EC.

config EC_A500_LEDS
	tristate "LEDs support for Acer A50x"
	depends on MFD_EC_A500 && LEDS_CLASS
	help
	  Say Y to enable control of power button leds.
```

## drivers/staging/a500/touchscreen/Kconfig
```kconfig
config TOUCHSCREEN_ATMEL_MXT_A500
	tristate "A500 Atmel mXT I2C Touchscreen"
	depends on INPUT_TOUCHSCREEN && I2C && ARCH_TEGRA
	help
	  Say Y here if you have Atmel mXT series I2C touchscreen,
	  found on Acer A500 tablet device.

	  If unsure, say N.

	  To compile this driver as a module, choose M here: the
	  module will be called atmel_mxt_ts_a500.
```

## drivers/staging/tegra-vde/Kconfig
```kconfig
config TEGRA_VDE
	tristate "NVIDIA Tegra20 video decoder driver"
	depends on ARCH_TEGRA_2x_SOC
	help
	    Say Y here to enable support for a NVIDIA Tegra20 video decoder
	    driver.
```

## drivers/staging/tegra/Kconfig
```kconfig
config TEGRA_DOWNSTREAM
	bool "Downstream NVIDIA Tegra drivers"
	depends on ARCH_TEGRA && !CONFIG_TEGRA20_MC
	default n
	help
	  Say Y to build downstream NVIDIA Tegra 2/3 drivers.

if TEGRA_DOWNSTREAM

source "drivers/staging/tegra/video/Kconfig"

endif # TEGRA_DOWNSTREAM
```

## drivers/staging/tegra/media/Kconfig
```kconfig
config VIDEO_TEGRA_V4L
	bool "Tegra soc_camera host driver"
	depends on VIDEO_DEV && ARCH_TEGRA && SOC_CAMERA
	select VIDEOBUF2_CORE
	select VIDEOBUF2_MEMOPS
	default y
	---help---
	  This is a v4l2 driver for the Tegra camera interface
```
